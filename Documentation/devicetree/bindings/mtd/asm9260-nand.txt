## Documentation/devicetree/bindings/mtd/asm9260-nand.txt
```
* Alphascales's ASM9260 NAND Flash Controller (NFC)

Required properties:
- compatible: "alphascale,asm9260-nand"
- reg: address range of the nfc block
- interrupts: irq to be used
- nand-max-chips: maximal number of attached chips. asm9260 support max 2.
- clocks: clock ids.
- clock-names:
	* 0 "mod" : nand controller clock.
	* 1 "ahb" : AHB gating clock.

Optional properties:
- nand-ecc-strength: see nand.txt
- nand-ecc-mode: see nand.txt
- nand-on-flash-bbt: see nand.txt

Example:

	nand@d8000000 {
		compatible = "alphascale,asm9260-nand";
		reg = <0x80600000 0x100>;
		interrupts = <29>;
		nand-max-chips = <1>;
		clocks = <&acc CLKID_SYS_NAND>, <&acc CLKID_AHB_NAND>;
		clock-names = "mod", "ahb";

		nand@0 {
			reg = <0>;
			nand-ecc-strength = <4>;
			nand-ecc-mode = "hw";
		};
	};
```

## Documentation/devicetree/bindings/pinctrl/alphascale,asm9260-pinctrl.txt
```
* Alphascale ASM9260 SoC pinctrl core driver

The pinctrl driver enables Alphascale ASM9260 to configure pin multiplexing
to a specific function.

Required properties for pinctrl driver:
- compatible: "alphascale,asm9260-pinctrl"
- reg: Register base of the MPP block and length.
- clocks: clock ids.
- clock-names:
	* 1 "ahb" : AHB gating clock.

Please refer to pinctrl-bindings.txt in this directory for details of the
common pinctrl bindings used by client devices, including the meaning of the
phrase "pin configuration node".

The pin configuration nodes act as a container for an arbitrary number of
subnodes. Each of these subnodes represents some desired configuration for a
pin or a list of pins. This configuration can include the
mux function to select on those pin(s), and various pin configuration
parameters, as listed below.

SUBNODES:

The name of each subnode is not important; all subnodes should be enumerated
and processed purely based on their content.

Each subnode only affects those parameters that are explicitly listed. In
other words, a subnode that lists a mux function but no pin configuration
parameters implies no information about any pin configuration parameters.
Similarly, a pin subnode that describes a pullup parameter implies no
information about e.g. the mux function.

The following generic properties as defined in pinctrl-bindings.txt are valid
to specify in a pin configuration subnode:
pins			- the list of pins that properties in the node
			  apply to (either this or "groups" has to be
			  specified)
function		- the mux function to select
bias-disable		- disable any pin bias
bias-pull-up		- pull up the pin. Supported only on GPIO0_* pins.
bias-pull-down		- pull down the pin. Supported on all pins except of GPIO0_*.

Examples:

pinctrl: pinctrl@80044000 {
	compatible = "alphascale,asm9260-pinctrl";
	reg = <0x80044000 0x400>;
	clocks = <&acc CLKID_AHB_IOCONFIG>;
	clock-names = "ahb";

        nand_fc0_pins_a: nand_fc0 {
                nand_main_gr {
                        pins = "GPIO11_0", "GPIO11_1", "GPIO11_2",
                               "GPIO11_3", "GPIO11_4", "GPIO11_6",
                               "GPIO12_0", "GPIO12_1", "GPIO12_2",
                               "GPIO12_3", "GPIO12_4", "GPIO12_5",
                               "GPIO12_6", "GPIO12_7";
                        function = "nand0";
                        bias-disable;
                };
        };
};

nand_controller0 {
        status = "okay";
        #address-cells = <1>;
        #size-cells = <1>;
        nand-ecc-strength = <4>;
        nand-ecc-step-size = <512>;
        nand-max-chips = <1>;
        nand-on-flash-bbt;

        pinctrl-names = "default";
        pinctrl-0 = <&nand_fc0_pins_a>;
};
```

## Documentation/devicetree/bindings/reset/alphascale,asm9260.txt
```
Alphascale asm9260Peripheral Reset Controller
===========================================

Please also refer to reset.txt in this directory for common reset
controller binding usage.

Required properties:
- compatible: Should be one of the following:
  "alphasclae,asm9260-reset"
- reg: should be register base and length as documented in the
  datasheet
- #reset-cells: 1, see below

example:

rst: reset@80040000 {
	compatible = "alphascale,asm9260-reset";
	#reset-cells = <1>;
	reg = <0x80040000 0x20>;
};
```

## drivers/icc/Kconfig
```kconfig
#
# ICC driver configuration
#
menuconfig ICC
	tristate "ICC support"
	---help---
	  The "Inter-Chip Communication" support

if ICC
# add transport here


endif # ICC
```

## drivers/net/dsa/qca/Kconfig
```kconfig
# SPDX-License-Identifier: GPL-2.0-only
config NET_DSA_AR9331
	tristate "Atheros AR9331 Ethernet switch support"
	depends on NET_DSA
	select NET_DSA_TAG_AR9331
	select REGMAP
	---help---
	  This enables support for the Atheros AR9331 build-in Ethernet
	  switch.
```
